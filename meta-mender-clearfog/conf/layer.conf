## meta-mender-clearfog/conf/layer.conf
```bitbake
# Copyright 2019 Northern.tech AS

# We have a conf and classes directory, add to BBPATH
BBPATH .= ":${LAYERDIR}"

# We have recipes-* directories, add to BBFILES
BBFILES += "${LAYERDIR}/recipes-*/*/*.bb \
	${LAYERDIR}/recipes-*/*/*.bbappend"

BBFILE_COLLECTIONS += "mender-clearfog"
BBFILE_PATTERN_mender-clearfog = "^${LAYERDIR}/"
BBFILE_PRIORITY_mender-clearfog = "10"

LAYERSERIES_COMPAT_mender-clearfog = "warrior"
LAYERDEPENDS_mender-clearfog = "mender clearfog"

MACHINE_FEATURES = "ext2 ext3 ipsec nfs pci smbfs usbgadget usbhost vfat"

WKS_FILE = "clearfog.wks"
WKS_FILE_DEPENDS = "virtual/bootloader clearfog-u-boot-scr"
```

## meta-mender-clearfog/conf/machine/include/clearfog-common.inc
```bitbake
UBOOT_BINARY = "u-boot-spl.kwb"

MACHINE_FEATURES = "ext2 ext3 ipsec nfs pci smbfs usbgadget usbhost vfat"

WKS_FILE = "clearfog.wks"
WKS_FILE_DEPENDS = "virtual/bootloader clearfog-u-boot-scr"
```
